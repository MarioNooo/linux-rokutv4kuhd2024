## linux_kernel-5.4.190/drivers/misc/mtktv_drivers/mk_drivers/Kconfig
```kconfig
# drivers/MStar/Kconfig

menu "MStar Platform Configuration"

#===================================================
# MStar Chip Selection
#===================================================
choice
	prompt "MStar Chip Selection"
	default None

config MSTAR_NONE
	bool "None"

config MSTAR_MT5896
	bool "MT5896"
	select ARCH_WANT_OPTIONAL_GPIOLIB
	select ARM_AMBA
	select ARM_TIMER_SP804
	select COMMON_CLKDEV
	select HAVE_CLK
	select ICST
	select PLAT_VERSATILE
	help
	 This enables support for the MT5867 32/64 bit mode kernel.

endchoice

#===================================================
# MStar Chip (auto-select)
# 0: None
# 1: Titania
# 2: Triton
# 3: Titania2
#===================================================
config MSTAR_CHIP_TYPE
	int
	default 1 if MSTAR_TITANIA
	default 2 if MSTAR_TRITON
	default 3 if MSTAR_TITANIA2
	default 4 if MSTAR_OBERON
	default 5 if MSTAR_EUCLID
	default 0

#===================================================
# MStar Chip Name (auto-select)
#===================================================
config MSTAR_CHIP_NAME
	string
	default "mt5896" if MSTAR_MT5896
	default "error"

#===================================================
#Chip based define
#===================================================
config MSTAR_ARM
    bool "Enable ARM BASE CPU"
    default n
config MSTAR_MIPS
    bool "Enable MIPS BASE CPU"
	depends on !MSTAR_ARM
    default n


#===================================================
#Android recovery Flag
#===================================================

config WRITE_TO_ANDROID_MISC
    bool "Write Andorid recovery command to partition"
    default n

choice
  depends on WRITE_TO_ANDROID_MISC
	prompt "storage type"
	default EMMC

config WRITE_TO_ANDROID_MISC_EMMC
    bool "EMMC"

config WRITE_TO_ANDROID_MISC_NAND
    bool "NAND"
endchoice

config LX3_SUPPORT
    bool "LX3 support"
    default n


#===================================================
# CPU HOTPLUG
#===================================================
config MSTAR_CPU_HOTPLUG
    bool "Enable Mstar cpu hotplug"
    depends on HOTPLUG_CPU
    default n


if !MSTAR_NONE
#==========================================
# Remove this latter - cc.chen
#==========================================
config MSTAR_ARM_MMAP_GENERIC
        depends on MSTAR_ARM
        bool "Generic Memory Map (ARM)"

config MSTAR_ARM_BD_GENERIC
	bool "Generic Board Setting"


#===================================================
# MStar Device Drivers
#===================================================
comment "MStar Device Drivers"

config MSTAR_UDEV_NODE
    bool "use udev to genrate device node"
    default n

config ROKU_MSTAR_DRIVER_MODIFY
    bool "roku mstar driver modify"
    default y

source "$(KERNEL_PATH_MSTAR2)/drv/mpool/Kconfig"
source "$(KERNEL_PATH_MSTAR2)/drv/system/Kconfig"
#source "$(KERNEL_PATH_MSTAR2)/drv/gflip/Kconfig"
source "$(KERNEL_PATH_MSTAR2)/drv/graphic/Kconfig"
source "$(KERNEL_PATH_MSTAR2)/drv/xc/Kconfig"
source "$(KERNEL_PATH_MSTAR2)/drv/dolby/Kconfig"
#source "$(KERNEL_PATH_MSTAR2)/drv/tch/Kconfig"
source "$(KERNEL_PATH_MSTAR2)/drv/hdr10plus_ref/Kconfig"
source "$(KERNEL_PATH_MSTAR2)/drv/semutex/Kconfig"
source "$(KERNEL_PATH_MSTAR2)/drv/sc/Kconfig"
source "$(KERNEL_PATH_MSTAR2)/drv/cma_pool/Kconfig"
source "$(KERNEL_PATH_MSTAR2)/drv/pm/Kconfig"
source "$(KERNEL_PATH_MSTAR2)/drv/r2/Kconfig"
source "$(KERNEL_PATH_MSTAR2)/drv/alsa_audio_driver/Kconfig"
endif
source "$(KERNEL_PATH_MSTAR2)/drv/armce_test/Kconfig"
source "$(KERNEL_PATH_MSTAR2)/drv/iomap/Kconfig"
endmenu
```

## linux_kernel-5.4.190/drivers/misc/mtktv_drivers/mk_drivers/drv/armce_test/Kconfig
```kconfig
config MP_ARMCE_TEST
	tristate "Arm Crypto Extension booting test"
	default n
	help
		Arm Crypto Extension booting test
```

## linux_kernel-5.4.190/drivers/misc/mtktv_drivers/mk_drivers/drv/cma_pool/Kconfig
```kconfig
config MSTAR_CMAPOOL
	bool  "CMA POOL"
	depends on CMA
	select MP_PLATFORM_UTOPIA2_INTERRUPT

	help
		MStar CMA POOL driver function
```

## linux_kernel-5.4.190/drivers/misc/mtktv_drivers/mk_drivers/drv/iomap/Kconfig
```kconfig
config MSTAR_IOMAP
	tristate "IOMAP"
	depends on MTK_TV_SLT
	help
	  MStar IO remap driver function
```

## linux_kernel-5.4.190/drivers/misc/mtktv_drivers/mk_drivers/drv/mpool/Kconfig
```kconfig
config MSTAR_MPOOL
	tristate "MPOOL"
	depends on ARM || ARM64
	help
	  MStar MPOOL driver function
```

## linux_kernel-5.4.190/drivers/misc/mtktv_drivers/mk_drivers/drv/pm/Kconfig
```kconfig
config MSTAR_PM

tristate "PM"

select APM_EMULATION

help
    MStar PM driver function
```

## linux_kernel-5.4.190/drivers/misc/roku/Kconfig
```kconfig
config ROKU_BACKLIGHT
	tristate "Roku backlight state driver"
	default y
		select PWM_MT5896
		select GPIO_MT5896
		select I2C_MT5896
	help
	  Stores the backlight state in kernel's bss_noinit section.

config ROKU_EARLY_PWR_MODE_HANDLER
	tristate "Roku early pwr mode handler driver"
	depends on ROKU_BACKLIGHT
	default y
		select MT5896_SARADC
		select IRS_MTK
	help
	  Handles early pwr mode events prior to Application.

config ROKU_UTPA_GOP
	tristate "Roku gop integrate with utopia"
	default n
	help
	  gop integrate with utopia.

config ROKU_KPI
	bool "Roku firmware kpi metrics driver"
	help
	  Enables Roku firmware kpi metric driver which helps in measuring
	  different firmware kpi

config ROKU_BOARD_ID
	tristate "Roku BOARD"
	default y
	help
	  To support Roku global TV hardware

config ROKU_COMPONENT_INFO
	bool "Roku MTK component information"
	default n
	---help---
    	To enable or to disable Roku MTK component information

config ROKU_LDMLED
	tristate "Roku local dimming led driver"
	default y
	help
	  Directly drive local dimming led drivces for mculess local dimming TV
```

## linux_kernel-5.4.190/drivers/mtd/nand/Kconfig
```kconfig
# SPDX-License-Identifier: GPL-2.0-only
config MTD_NAND_CORE
	tristate

config ROKU_MTD_NAND_ENCRYPTION
	bool "Support for ROKU MTD NAND partition encryption"
	depends on MTD_NAND
	help
	   Enables per-partition encryption of NAND devices. This has
	   several side effects: encrypted NAND is no longer bit
	   writable, and both reads and writes must be aligned on
	   block (writesize) boundaries.

source "drivers/mtd/nand/onenand/Kconfig"
source "drivers/mtd/nand/raw/Kconfig"
source "drivers/mtd/nand/spi/Kconfig"
```

## linux_kernel-5.4.190/drivers/mtd/nand/raw/mtk-dtv/Kconfig
```kconfig
config MTD_NAND_MTK_DTV
	tristate "MTK DTV NAND controller"
	depends on ARCH_MEDIATEK_DTV || COMPILE_TEST
	depends on HAS_IOMEM
	help
	  Enables support for NAND controller on MTK DTV SoCs.
	  This controller is found on mt5873 SoCs.
config ROKU_MTD_NAND_MODIFY
	tristate "Roku fetch NAND partname"
```

## linux_kernel-5.4.190/drivers/swupd/Kconfig
```kconfig
menuconfig ROKU_SWUPD
    tristate "ROKU_SWUPD support"
    depends on MTD
    help
	    Software Update driver to handle writes to flash for single partition software update
```
